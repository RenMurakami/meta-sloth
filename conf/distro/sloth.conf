## conf/layer.conf
```bitbake
# Sloth - product layer (thermal-camera deer detection ECU)
BBPATH .= ":${LAYERDIR}"
BBFILES += "${LAYERDIR}/recipes-*/*/*.bb ${LAYERDIR}/recipes-*/*/*.bbappend"

BBFILE_COLLECTIONS += "sloth"
BBFILE_PATTERN_sloth = "^${LAYERDIR}/"
BBFILE_PRIORITY_sloth = "60"

LAYERDEPENDS_sloth = "core tegra tegrademo openembedded-layer meta-python networking-layer"
LAYERSERIES_COMPAT_sloth = "wrynose"

BBFILES_DYNAMIC += "swupdate:${LAYERDIR}/dynamic-layers/meta-swupdate/recipes-*/*/*.bb"
```
